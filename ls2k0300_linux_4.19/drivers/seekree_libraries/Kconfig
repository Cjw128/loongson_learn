## ls2k0300_linux_4.19/drivers/seekree_libraries/Kconfig
```kconfig
menuconfig SEEKFREE_KERNEL_DRIVER
	bool "seekfree kernel driver Support"
	help
	  seekfree kernel driver support.


if SEEKFREE_KERNEL_DRIVER

config ZF_DEVICE_IMU660RA
	tristate "zf_device_imu660ra support"
	depends on CPU_LOONGSON3 || CPU_LOONGSON2K || CPU_LOONGSON64
	
	help
	  Turn this option on and support the IMU660RA, 
	  which has a three-axis accelerometer and a three-axis gyroscope. 
	  Currently, an analog SPI is used, initialized as an IIO device.

config ZF_DEVICE_IMU963RA
	tristate "zf_device_imu963ra support"
	depends on CPU_LOONGSON3 || CPU_LOONGSON2K || CPU_LOONGSON64

	help
	  Turn on this option to support the IMU963RA, 
	  which has a three-axis accelerometer and 
	  a three-axis gyroscope and a three-axis magnetometer. 
	  Currently, an analog SPI is used, initialized as an IIO device.

config ZF_DRIVER_ATIM 
	tristate "zf_driver_atim support"
	depends on CPU_LOONGSON3 || CPU_LOONGSON2K || CPU_LOONGSON64
	help
	  ATIM PWM framework driver for loongson2k.

config ZF_DRIVER_ENCODER
	tristate "zf_driver_encoder support"
	depends on CPU_LOONGSON3 || CPU_LOONGSON2K || CPU_LOONGSON64
	help
	  ATIM PWM framework driver for loongson2k.
	  
config ZF_DRIVER_GPIO 
	tristate "zf_driver_gpio support"
	depends on CPU_LOONGSON3 || CPU_LOONGSON2K || CPU_LOONGSON64
	help
	  GPIO framework driver for loongson2k.

	  Turning this option on will initialize the GPIO device 
	  in the device tree as a device file. 
	  You only need to read and write this file to operate the GPIO.


config ZF_DRIVER_GTIM 
	tristate "zf_driver_gtim support"
	depends on CPU_LOONGSON3 || CPU_LOONGSON2K || CPU_LOONGSON64
	help
	  ATIM PWM framework driver for loongson2k.

	  To compile this driver as a module, choose M here: the module
	  will be called pwm-ls-atim.

config ZF_DRIVER_PWM
	tristate "zf_driver_pwm support"
	depends on CPU_LOONGSON3 || CPU_LOONGSON2K || CPU_LOONGSON64
	help
	  ATIM PWM framework driver for loongson2k.

	  Turning this option on initializes 
	  the PWM device in the device tree as a device file. 
	  You only need to read and write 
	  this file to operate the PWM device.

endif
```
